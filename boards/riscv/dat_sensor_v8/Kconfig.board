## boards/riscv/dat_sensor_v8/Kconfig.board
```kconfig
# ESP32C3 devkitm board configuration

# Copyright (c) 2021 Espressif Systems (Shanghai) Co., Ltd.
# SPDX-License-Identifier: Apache-2.0

config BOARD_DAT_SENSOR_V8
	bool "Dat sensor V8"
	depends on SOC_SERIES_ESP32C3
```

## boards/riscv/dat_sensor_v8/Kconfig.defconfig
```kconfig
# ESP32C3 devkitm board configuration

# Copyright (c) 2021 Espressif Systems (Shanghai) Co., Ltd.
# SPDX-License-Identifier: Apache-2.0

config BOARD
	default "dat_sensor_v8"
	depends on BOARD_DAT_SENSOR_V8

config HEAP_MEM_POOL_SIZE
	default 98304 if WIFI
	default 40960 if BT
	default 4096

choice BT_HCI_BUS_TYPE
	default BT_ESP32 if BT
endchoice
```
